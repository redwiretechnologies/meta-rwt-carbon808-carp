## conf/layer.conf
```bitbake
#We have a conf and classes directory, add to BBPATH
BBPATH .= ":${LAYERDIR}"

# We have recipes-* directories, add to BBFILES
BBFILES += "${LAYERDIR}/recipes-*/*/*.bb \
	${LAYERDIR}/recipes-*/*/*.bbappend"

BBFILE_COLLECTIONS += "meta-rwt-carbon808-carp"
BBFILE_PATTERN_meta-rwt-carbon808-carp = "^${LAYERDIR}/"
BBFILE_PRIORITY_meta-rwt-carbon808-carp = "10"

LAYERSERIES_COMPAT_meta-rwt-carbon808-carp = "kirkstone"
```
